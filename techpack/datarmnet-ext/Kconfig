## techpack/datarmnet-ext/Kconfig
```kconfig
source "techpack/datarmnet-ext/offload/Kconfig"

source "techpack/datarmnet-ext/shs/Kconfig"
```

## techpack/datarmnet-ext/offload/Kconfig
```kconfig
#
# RMNET_OFFLOAD driver
#

config RMNET_OFFLOAD
    tristate "Rmnet offload support"
    default y
    depends on RMNET_CORE
    ---help---
        Offload support for the RmNet driver
```

## techpack/datarmnet-ext/shs/Kconfig
```kconfig
#
# RMNET_SHS driver
#

config RMNET_SHS
    tristate "Rmnet SHS driver"
    default y
    depends on RMNET_CORE
    ---help---
        performance mode of rmnet driver
```

## techpack/datarmnet/core/Kconfig
```kconfig
#
# RMNET MAP driver
#

config RMNET_CORE
	tristate "Rmnet Core driver"
	default y 
	select GRO_CELLS
	---help---
	  If you select this, you will enable the RMNET module which is used
	  for handling data in the multiplexing and aggregation protocol (MAP)
	  format in the embedded data path. RMNET devices can be attached to
	  any IP mode physical device.

config RMNET_CTL
	tristate "Rmnet Ctl driver"
	default y
	---help---
	  Enable the RMNET CTL module which is used for handling QMAP commands
	  for flow control purposes.
```
